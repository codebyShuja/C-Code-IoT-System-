#include <Servo.h>
  //-----------------------------------------------------------------------
  //-------------------------Declare veriables, for robot functions--------
  //-----------------------------------------------------------------------
char speak;
Servo servoRightelbow;
Servo servoLeftelbow;
Servo servoLeftArm;
Servo servoRightArm;
  //-----------------------------------------------------------------------
  //-------------------------Pins Details here-----------------------------
  //-----------------------------------------------------------------------
void setup() {
pinMode (8,OUTPUT);
pinMode(9,OUTPUT);
pinMode(10,OUTPUT);
servoLeftelbow.attach(11);
servoRightelbow.attach(12);
servoLeftArm.attach(6);
servoRightArm.attach(7);
Serial.begin(9600);
}

void loop() {
  speak = Serial.read();
  if (speak=='L')
  {
    digitalWrite(8,HIGH);
  
    //-----------------------------------------------------------------------
  //-------------------------Move robot forward or stop it-----------------
  //-----------------------------------------------------------------------
  if (speak=='A')
  {
 digitalWrite(9,HIGH);
 digitalWrite(10,HIGH);
  }
  else if (speak=='B')
  {
 digitalWrite(9,LOW);
 digitalWrite(10,LOW);
  }
  //-----------------------------------------------------------------------
  //-------------------------Albo(Arm) movment ----------------------------
  //-----------------------------------------------------------------------
  else if (speak=='C')
  {
  LeftelbowUp();
    }
     else if (speak=='D')
  {
    LeftelbowDown();
    }
     else if (speak=='E')
  {
   RightelbowUp();
    }
     else if (speak=='F')
  {
    RightelbowDown();
    }
  //-----------------------------------------------------------------------
  //-------------------------Arm movment ----------------------------------
  //-----------------------------------------------------------------------
  else if (speak=='g')
  {
    LeftArmUp();
    }
     else if (speak=='h')
  {
    LeftArmDown();
    }
     else if (speak=='i')
  {
    RightArmUp();
    }
     else if (speak=='j')
  {
    RightArmDown();
    }
  }
}
//========================================================================================================
//========================================================================================================
//========================================================================================================
//==================================Functions defination codeing start here===============================
//========================================================================================================
//========================================================================================================
//========================================================================================================

  //-----------------------------------------------------------------------
  //------------------------Elbow Conotrol code here-----------------------
  //-----------------------------------------------------------------------
     void LeftelbowUp()
  {  servoLeftelbow.write(180);
    }
     void LeftelbowDown()
  {  servoLeftelbow.write(90);
    }
     void RightelbowUp()
  {  servoRightelbow.write(180);
    }
     void RightelbowDown()
  {  servoRightelbow.write(90);
    }
  //-----------------------------------------------------------------------
  //-------------------------Arms Conotrol code here-----------------------
  //-----------------------------------------------------------------------
    void LeftArmUp()
    {  servoLeftArm.write(180);
      }
    void LeftArmDown()
    {  servoLeftArm.write(90);
      }
    void RightArmUp()
    {  servoRightArm.write(180);
      }
    void RightArmDown()
    {  servoRightArm.write(90);
      }






  
